## yocto/meta-rpi-ili9341-bsp/conf/layer.conf
```bitbake
BBPATH .= ":${LAYERDIR}"

BBFILES += "${LAYERDIR}/recipes-*/*/*.bb \
            ${LAYERDIR}/recipes-*/*/*.bbappend"

BBFILE_COLLECTIONS += "rpiili9341bsp"

BBFILE_PATTERN_rpiili9341bsp = "^${LAYERDIR}/"

BBFILE_PRIORITY_rpiili9341bsp = "10"

LAYERDEPENDS_rpiili9341bsp = "core raspberrypi qt6-layer"
LAYERSERIES_COMPAT_rpiili9341bsp = "kirkstone"
```
