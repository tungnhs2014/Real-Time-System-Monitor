## yocto/meta-rpi-ili9341-bsp/conf/local.conf
```bitbake
# ============================================================
# FINAL Qt6 CONFIGURATION FOR ILI9341
# Project: Raspberry Pi 3B+ + ILI9341 + Qt6 Monitoring
# Author: TungNHS
# Date: November 2025
# ============================================================

# ============================================================
# MACHINE & DISTRO
# ============================================================
MACHINE ??= "raspberrypi3-64"
DISTRO ?= "poky"
PACKAGE_CLASSES ?= "package_ipk"

# ============================================================
# SHARED CACHE
# ============================================================
DL_DIR ?= "${TOPDIR}/../downloads"
SSTATE_DIR ?= "${TOPDIR}/../sstate-cache"

# ============================================================
# PARALLEL BUILD - Adjust based on your RAM
# 8GB RAM: use 2, 16GB+: use 4
# ============================================================
BB_NUMBER_THREADS = "2"
PARALLEL_MAKE = "-j 2"

# ============================================================
# DISTRO FEATURES
# No opengl needed for linuxfb (SPI display)
# ============================================================
DISTRO_FEATURES:append = " systemd wifi bluetooth"
DISTRO_FEATURES:remove = "x11 wayland vulkan ptest"

VIRTUAL-RUNTIME_init_manager = "systemd"
VIRTUAL-RUNTIME_initscripts = "systemd-compat-units"

# ============================================================
# RASPBERRY PI HARDWARE
# ============================================================
ENABLE_UART = "1"
ENABLE_SPI_BUS = "1"
ENABLE_I2C = "1"
GPU_MEM = "64"

KERNEL_MODULE_AUTOLOAD += "spi-bcm2835 i2c-dev"

# ============================================================
# BASE PACKAGES
# ============================================================
IMAGE_INSTALL:append = " \
    kernel-modules \
    kernel-devicetree \
    linux-firmware \
"

# ============================================================
# NETWORKING
# ============================================================
IMAGE_INSTALL:append = " \
    openssh \
    openssh-sftp-server \
    openssh-scp \
    dhcpcd \
    wpa-supplicant \
    iw \
    linux-firmware-bcm43430 \
    linux-firmware-bcm43455 \
    iptables \
    net-tools \
    iputils \
    curl \
    wget \
    rsync \
"

# ============================================================
# Qt6 TARGET PACKAGES
# ============================================================
IMAGE_INSTALL:append = " \
    qtbase \
    qtbase-plugins \
    qtbase-tools \
    qtdeclarative \
    qtdeclarative-qmlplugins \
    qtdeclarative-tools \
    qtcharts \
    qtsvg \
    qtsvg-plugins \
"

# ============================================================
# Qt6 DEVELOPMENT (Target)
# ============================================================
IMAGE_INSTALL:append = " \
    qtbase-dev \
    qtdeclarative-dev \
    qtsvg-dev \
"

# ============================================================
# Qt6 PLATFORM CONFIG 
# ============================================================
PACKAGECONFIG:append:pn-qtbase = " \
    linuxfb \
    tslib \
    libinput \
    fontconfig \
    harfbuzz \
    jpeg \
    png \
    no-opengl \
"

# Remove EGLFS/OpenGL
PACKAGECONFIG:remove:pn-qtbase = " \
    xcb \
    xkbcommon \
    eglfs \
    kms \
    gbm \
    gles2 \
    gl \
"



# ============================================================
# TOUCH & INPUT SUPPORT
# ============================================================
IMAGE_INSTALL:append = " \
    tslib \
    tslib-calibrate \
    tslib-tests \
    tslib-conf \
    libinput \
    libinput-bin \
    mtdev \
    libevdev \
    evtest \
"

# ============================================================
# FONTS - COMPLETE with EMOJI for icons
# ============================================================
IMAGE_INSTALL:append = " \
    fontconfig \
    fontconfig-utils \
"

# DejaVu fonts (good Unicode coverage)
IMAGE_INSTALL:append = " \
    ttf-dejavu-sans \
    ttf-dejavu-sans-mono \
    ttf-dejavu-serif \
    ttf-dejavu-sans-condensed \
    ttf-dejavu-common \
"

# Liberation fonts (Microsoft compatible)
IMAGE_INSTALL:append = " \
    liberation-fonts \
"

# ============================================================
# IMAGE FORMAT PLUGINS
# ============================================================
IMAGE_INSTALL:append = " \
    qtimageformats \
"

# ============================================================
# SYSTEM MONITORING TOOLS
# ============================================================
IMAGE_INSTALL:append = " \
    sysstat \
    lmsensors \
    htop \
"

# ============================================================
# DEVELOPMENT TOOLS (Target)
# Comment out to reduce image size for production
# ============================================================
IMAGE_INSTALL:append = " \
    gcc \
    g++ \
    make \
    cmake \
"

# ============================================================
# DEBUGGING & PROFILING
# ============================================================
IMAGE_INSTALL:append = " \
    gdb \
    gdbserver \
    strace \
"

# ============================================================
# EDITORS & UTILITIES
# ============================================================
IMAGE_INSTALL:append = " \
    nano \
    vim \
    less \
    tree \
    which \
    file \
"

# ============================================================
# FRAMEBUFFER TOOLS
# ============================================================
IMAGE_INSTALL:append = " \
    fbset \
"

# ============================================================
# SYSTEM UTILITIES
# ============================================================
IMAGE_INSTALL:append = " \
    procps \
    psmisc \
    findutils \
    grep \
    sed \
    gawk \
    coreutils \
    util-linux \
    tar \
    gzip \
    bzip2 \
    xz \
    unzip \
    zip \
"

# ============================================================
# PYTHON3
# ============================================================
IMAGE_INSTALL:append = " \
    python3 \
    python3-pip \
    python3-setuptools \
"

# ============================================================
# DEVELOPMENT FEATURES
# ============================================================
EXTRA_IMAGE_FEATURES = "debug-tweaks ssh-server-openssh package-management"

# ============================================================
# IMAGE FORMAT & SIZE
# ============================================================
IMAGE_FSTYPES = "rpi-sdimg ext4 tar.xz"
IMAGE_ROOTFS_EXTRA_SPACE = "1048576"

IMAGE_INSTALL:append = " haveged"

# ============================================================
# SDK CONFIGURATION
# ============================================================
SDKMACHINE = "x86_64"

TOOLCHAIN_HOST_TASK:append = " \
    nativesdk-qtbase \
    nativesdk-qtbase-tools \
    nativesdk-qtbase-dev \
    nativesdk-qtdeclarative \
    nativesdk-qtdeclarative-tools \
    nativesdk-qtdeclarative-dev \
    nativesdk-cmake \
    nativesdk-ninja \
    nativesdk-pkgconfig \
    nativesdk-python3 \
"

TOOLCHAIN_TARGET_TASK:append = " \
    qtbase-dev \
    qtdeclarative-dev \
    qtcharts-dev \
    qtsvg-dev \
    kernel-devsrc \
"

PACKAGECONFIG:append:pn-nativesdk-qtbase = " tools linuxfb fontconfig"
PACKAGECONFIG:remove:pn-nativesdk-qtbase = "xcb xkbcommon eglfs"

TOOLCHAIN_HOST_TASK:append = " \
    nativesdk-perl \
    nativesdk-perl-modules \
"

# ============================================================
# BUILD OPTIMIZATION
# ============================================================
INHERIT += "rm_work"

RM_WORK_EXCLUDE += " \
    linux-raspberrypi \
    qtbase \
    qtdeclarative \
"

BB_GIT_SHALLOW = "1"
BB_GIT_SHALLOW_DEPTH = "1"

# ============================================================
# DISK MONITORING
# ============================================================
BB_DISKMON_DIRS ??= "\
    STOPTASKS,${TMPDIR},2G,100K \
    STOPTASKS,${DL_DIR},2G,100K \
    STOPTASKS,${SSTATE_DIR},2G,100K \
    HALT,${TMPDIR},100M,1K \
    HALT,${DL_DIR},100M,1K \
    HALT,${SSTATE_DIR},100M,1K"

# ============================================================
# LICENSING
# ============================================================
LICENSE_FLAGS_ACCEPTED = "commercial"

# ============================================================
# MISC
# ============================================================
PATCHRESOLVE = "noop"
CONF_VERSION = "2"
USER_CLASSES ?= "buildstats"
```

## yocto/meta-system-monitor/conf/layer.conf
```bitbake
# Layer identification
BBPATH .= ":${LAYERDIR}"

# Recipe paths
BBFILES += "${LAYERDIR}/recipes-*/*/*.bb \
            ${LAYERDIR}/recipes-*/*/*.bbappend"

# Layer name
BBFILE_COLLECTIONS += "systemmonitor"

# Recipe pattern match
BBFILE_PATTERN_systemmonitor = "^${LAYERDIR}/"

# Layer priority
BBFILE_PRIORITY_systemmonitor = "8"

# Layer compatibility
LAYERDEPENDS_systemmonitor = "core meta-qt6"
LAYERSERIES_COMPAT_systemmonitor = "kirkstone"
```
